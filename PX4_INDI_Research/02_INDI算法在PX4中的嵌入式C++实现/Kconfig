## PX4_INDI_Research/02_INDI算法在PX4中的嵌入式C++实现/Kconfig
```kconfig
menuconfig MODULES_RATE_CONTROL_INDI
	bool "rate_control_indi"
	default n
	---help---
		Enable support for Incremental Nonlinear Dynamic Inversion (INDI) angular rate controller.
```
